## main/Kconfig.projbuild
```kconfig
menu "E-Display GPIOs"

config LED_GPIO
    int "LED GPIO number"
	range 0 34
	default 2
	help
		GPIO number where "light" gpio is attached to.

		Some GPIOs are used for other purposes (flash connections, etc.) and cannot be used to blink.

		GPIOs 35-39 are input-only so cannot be used as outputs.

config BUTTON_GPIO
    int "Button GPIO number"
	range 0 39
	default 0
	help
		GPIO number where "light" gpio is attached to.

		Some GPIOs are used for other purposes (flash connections, etc.) and cannot be used to blink.

		GPIOs 35-39 are input-only so cannot be used as outputs.

config DAC_GPIO
    int "DAC GPIO number"
	range 0 34
	default 25
	help
		GPIO number where "DAC" gpio is attached to.

		Some GPIOs are used for other purposes (flash connections, etc.) and cannot be used to blink.

		GPIOs 35-39 are input-only so cannot be used as outputs.


config CS_GPIO
    int "CS GPIO number"
	range 0 34
	default 13
	help
		GPIO number (IOxx) for CS pin.

		Some GPIOs are used for other purposes (flash connections, etc.) and cannot be used to blink.

		GPIOs 35-39 are input-only so cannot be used as outputs.

config CLK_GPIO
    int "CLK GPIO number"
	range 0 34
	default 12
	help
		GPIO number (IOxx) for BUSY pin.

		Some GPIOs are used for other purposes (flash connections, etc.) and cannot be used to blink.

		GPIOs 35-39 are input-only so cannot be used as outputs.
config MISO_GPIO
    int "MISO GPIO number"
	range 0 34
	default 15
	help
		GPIO number (IOxx) for BUSY pin.

		Some GPIOs are used for other purposes (flash connections, etc.) and cannot be used to blink.

		GPIOs 35-39 are input-only so cannot be used as outputs.
config MOSI_GPIO
    int "MOSI GPIO number"
	range 0 34
	default 27
	help
		GPIO number (IOxx) for BUSY pin.

		Some GPIOs are used for other purposes (flash connections, etc.) and cannot be used to blink.

		GPIOs 35-39 are input-only so cannot be used as outputs.
config BUSY_GPIO
    int "BUSY GPIO number"
	range 0 34
	default 32
	help
		GPIO number (IOxx) for BUSY pin.

		Some GPIOs are used for other purposes (flash connections, etc.) and cannot be used to blink.

		GPIOs 35-39 are input-only so cannot be used as outputs.
config RST_GPIO
    int "RST GPIO number"
	range 0 34
	default 33
	help
		GPIO number (IOxx) for RST pin.

		Some GPIOs are used for other purposes (flash connections, etc.) and cannot be used to blink.

		GPIOs 35-39 are input-only so cannot be used as outputs.

config DC_GPIO
    int "DC GPIO number"
	range 0 34
	default 14
	help
		GPIO number (IOxx) for DC pin.

		Some GPIOs are used for other purposes (flash connections, etc.) and cannot be used to blink.

		GPIOs 35-39 are input-only so cannot be used as outputs.

config WIFI_SSID
    string "WiFi SSID"
	default "Wiilan"
	help
		SSID (network name) for the example to connect to.

config WIFI_PASSWORD
    string "WiFi Password"
	default "EvelinSimon8645"
	help
		WiFi password (WPA or WPA2) for the example to use.

		Can be left blank if the network has no security set.

config I2S_BCK
    int "I2S BCK"
	range 0 34
	default 1
	help

    GPIOs 35-39 are input-only so cannot be used as outputs.

config I2S_DOUT
    int "I2S DOUT"
	range 0 34
	default 22
	help

    GPIOs 35-39 are input-only so cannot be used as outputs.

config I2S_LCK
    int "I2S LCK"
	range 0 34
	default 23
	help

    The GPIO for I2S WS/LCK
    GPIOs 35-39 are input-only so cannot be used as outputs.

config I2C_SDA
    int "I2C SDA"
	range 0 34
	default 18
	help

    The GPIO for I2C SDA
    GPIOs 35-39 are input-only so cannot be used as outputs.

config I2C_SCL
    int "I2C SCL"
	range 0 34
	default 19
	help

    The GPIO for I2C SCL
    GPIOs 35-39 are input-only so cannot be used as outputs.
endmenu
```
